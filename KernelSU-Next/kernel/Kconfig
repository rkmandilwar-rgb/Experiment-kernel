## KernelSU-Next/kernel/Kconfig
```kconfig
menu "KernelSU"

config KSU
	tristate "KernelSU function support"
	default y
	help
	  Enable kernel-level root privileges on Android System.
	  Requires CONFIG_KPROBES for kernel hooking support.
	  To compile as a module, choose M here: the
	  module will be called kernelsu.

config KSU_DEBUG
	bool "KernelSU debug mode"
	depends on KSU
	default n
	help
	  Enable KernelSU debug mode.

config KSU_DISABLE_MANAGER
	bool "Disable KernelSU manager integration"
	depends on KSU
	default n
	help
	  Disable manager APK detection and manager-specific handling.
	  Root will be used in place of manager-only functionality.

config KSU_DISABLE_POLICY
	bool "Disable KernelSU policy profiles"
	depends on KSU
	default n
	help
	  Disable per-app root/non-root profile customization.
	  Escalation will always use the default full root profile, and
	  non-root handling will follow the global umount policy only.

config KSU_ALLOWLIST_WORKAROUND
	bool "KernelSU allowlist workaround"
	depends on KSU
	default n
	help
	  Enable workaround for broken allowlist save

# For easier extern ifdef handling
config KSU_MANUAL_HOOK
	bool "KernelSU manual hook mode."
	depends on KSU && KSU != m
	default y if !KPROBES
	default n
	help
	  Enable manual hook support.

choice
	prompt "KernelSU dynamic hook mode"
	depends on KSU && !KSU_MANUAL_HOOK
	default KSU_KPROBES_HOOK

config KSU_KPROBES_HOOK
	bool "KernelSU tracepoint+kretprobe hook"
	depends on KRETPROBES && KPROBES && HAVE_SYSCALL_TRACEPOINTS
	help
	  Enable KPROBES, KRETPROBES and TRACEPOINT hook for KernelSU core.
	  This should not be used on kernel below 5.10.

config KSU_SYSCALL_TABLE_HOOK
	bool "KernelSU syscall table patching hook"
	depends on ARM64 || X86_64
	help
	  Patch sys_call_table entries directly to hook syscalls without
	  kprobes or tracepoints. Intended for non-GKI kernels where kprobes
	  are unavailable or non-functional.
	  Requires kernel >= 4.17 (pt_regs-based syscall ABI).

endchoice

menu "KernelSU - SUSFS"
config KSU_SUSFS
	bool "KernelSU addon - SUSFS"
	depends on KSU
	depends on THREAD_INFO_IN_TASK
	default n
	help
	  Patch and enable SUSFS (v2.3.0) with KernelSU. SUSFS hides su
	  related artefacts (paths, mounts, kstat, maps) and spoofs uname,
	  cmdline and avc logs for user apps.

config KSU_SUSFS_SUS_PATH
	bool "Enable to hide suspicious path (NOT recommended)"
	depends on KSU_SUSFS
	default y
	help
	  Hide user-defined paths and their children from various system
	  calls. Effective only on zygote spawned user app processes.
	  May cost performance and is vulnerable to side channel attacks;
	  disable if it does not work for you.

config KSU_SUSFS_SUS_MOUNT
	bool "Enable to hide suspicious mounts"
	depends on KSU_SUSFS
	default y
	help
	  Hide user-defined mount paths from /proc/self/[mounts|mountinfo|
	  mountstats]. Effective on all processes. mnt_id and mnt_group_id
	  of the sus mounts are assigned from the high fake id range so
	  real ids stay contiguous.

config KSU_SUSFS_SUS_KSTAT
	bool "Enable to spoof suspicious kstat"
	depends on KSU_SUSFS
	default y
	help
	  Spoof the kstat of user-defined files/directories. Effective
	  only on zygote spawned user app processes.

config KSU_SUSFS_TRY_UMOUNT
	bool "Enable to use ksu's try_umount"
	depends on KSU_SUSFS
	default y
	help
	  Also umount user-defined mount paths before ksu's default
	  umount paths, on zygote spawned umounted user app processes.

config KSU_SUSFS_SPOOF_UNAME
	bool "Enable to spoof uname"
	depends on KSU_SUSFS
	default y
	help
	  Spoof the strings returned by the uname syscall with
	  user-defined strings. Effective on all processes.

config KSU_SUSFS_ENABLE_LOG
	bool "Enable logging susfs log to kernel"
	depends on KSU_SUSFS
	default y
	help
	  Log susfs activity to the kernel log. Uncheck to silence all
	  susfs logs.

config KSU_SUSFS_HIDE_KSU_SUSFS_SYMBOLS
	bool "Enable to automatically hide ksu and susfs symbols from /proc/kallsyms"
	depends on KSU_SUSFS
	default y
	help
	  Hide ksu_/__ksu_/susfs_/ksud/is_ksu_ symbols from /proc/kallsyms.
	  Effective on all processes.

config KSU_SUSFS_SPOOF_CMDLINE_OR_BOOTCONFIG
	bool "Enable to spoof /proc/cmdline (non-gki)"
	depends on KSU_SUSFS
	default y
	help
	  Spoof the output of /proc/cmdline with a user-defined string.
	  Effective on all processes.

config KSU_SUSFS_OPEN_REDIRECT
	bool "Enable to redirect a path to be opened with another path (experimental)"
	depends on KSU_SUSFS
	default y
	help
	  Redirect a target path to be opened as another user-defined
	  path. Effective only on processes with uid < 2000. Processes
	  with open access to both paths can detect the redirection.

config KSU_SUSFS_SUS_MAP
	bool "Enable to hide some mmapped real file from different proc maps interfaces"
	depends on KSU_SUSFS
	default y
	help
	  Hide mmapped real files from /proc/<pid>/[maps|smaps|map_files|
	  mem|pagemap]. Anon memory is not supported, and inline/plt hooks
	  from the injected library itself are not hidden. Effective only
	  on zygote spawned umounted user app processes.

endmenu

endmenu
```

## drivers/block/zram/Kconfig
```kconfig
# SPDX-License-Identifier: GPL-2.0
config ZRAM
	tristate "Compressed RAM block device support"
	depends on BLOCK && SYSFS && ZSMALLOC && CRYPTO
	select CRYPTO_LZO
	default n
	help
	  Creates virtual block devices called /dev/zramX (X = 0, 1, ...).
	  Pages written to these disks are compressed and stored in memory
	  itself. These disks allow very fast I/O and compression provides
	  good amounts of memory savings.

	  It has several use cases, for example: /tmp storage, use as swap
	  disks and maybe many more.

	  See Documentation/blockdev/zram.txt for more information.

config ZRAM_DEDUP
	bool "Deduplication support for ZRAM data"
	depends on ZRAM
	default n
	help
	  Deduplicate ZRAM data to reduce amount of memory consumption.
	  Advantage largely depends on the workload. In some cases, this
          option reduces memory usage to the half. However, if there is no
	  duplicated data, the amount of memory consumption would be
	  increased due to additional metadata usage. And, there is
	  computation time trade-off. Please check the benefit before
	  enabling this option. Experiment shows the positive effect when
	  the zram is used as blockdev and is used to store build output.

config ZRAM_WRITEBACK
       bool "Write back incompressible or idle page to backing device"
       depends on ZRAM
       default n
       help
	 With incompressible page, there is no memory saving to keep it
	 in memory. Instead, write it out to backing device.
	 For this feature, admin should set up backing device via
	 /sys/block/zramX/backing_dev.

	 With /sys/block/zramX/{idle,writeback}, application could ask
	 idle page's writeback to the backing device to save in memory.

	 See Documentation/blockdev/zram.txt for more information.

config ZRAM_MEMORY_TRACKING
	bool "Track zRam block status"
	depends on ZRAM && DEBUG_FS
	help
	  With this feature, admin can track the state of allocated blocks
	  of zRAM. Admin could see the information via
	  /sys/kernel/debug/zram/zramX/block_state.

	  See Documentation/blockdev/zram.txt for more information.

config ZRAM_ENTROPY
	bool "Skip compression for high-entropy ZRAM pages"
	depends on ZRAM
	default n
	help
	  Estimate page entropy before compression and store high-entropy pages
	  uncompressed. This can save compression CPU time at the cost of using
	  more memory for those pages. The threshold is available under
	  /proc/sys/vm/zram_entropy_threshold.

config ZRAM_ENTROPY_THRESHOLD
	int "ZRAM entropy threshold"
	depends on ZRAM && ZRAM_ENTROPY
	default 100000
	help
	  Pages with an entropy score above this value are stored uncompressed.
	  The default is tuned to the 4 KiB pages used on this platform.
```

## drivers/soc/oplus_nandswap/Kconfig
```kconfig
config NANDSWAP
	bool "Oplus NandSwap swap extension"
	default n
	help
	  Oplus NandSwap: dedicated swap-area management with nswapoutd /
	  nswapind / nswapdropd kernel threads, /proc/nandswap control
	  (fn_enable, dev_life, swap_ctl, swap_limit, life_protect,
	  stat_info), and swap-device tagging via the SWAP_NANDSWAP_PRIO
	  (2020) swap priority. Kernel-side port from the Oplus/realme
	  atoll msm-4.14 vendor sources.

config NANDSWAP_DEBUG
	bool "nandswap debug"
	depends on F2FS_FS
	default n
	help
	  nandswap debug
```
